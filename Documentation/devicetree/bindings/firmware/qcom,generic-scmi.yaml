## drivers/firmware/qcom/Kconfig
```kconfig
# SPDX-License-Identifier: GPL-2.0-only
#
# For a description of the syntax of this configuration file,
# see Documentation/kbuild/kconfig-language.rst.
#

menu "Qualcomm firmware drivers"

config QCOM_PAS
	tristate "Qualcomm generic PAS interface driver" if COMPILE_TEST
	help
	  Enable the generic Peripheral Authentication Service (PAS) provided
	  by the firmware. It acts as the common layer with different TZ
	  backends plugged in whether it's an SCM implementation or a proper
	  TEE bus based PAS service implementation.

config QCOM_PAS_TEE
	tristate "Qualcomm PAS TEE interface driver"
	depends on ARCH_QCOM || COMPILE_TEST
	select QCOM_PAS
	depends on TEE
	depends on !CPU_BIG_ENDIAN
	default m if ARCH_QCOM
	help
	  Enable the generic Peripheral Authentication Service (PAS) provided
	  by the firmware TEE implementation as the backend.

config QCOM_SCM
	tristate "Qualcomm PAS SCM interface driver" if ARCH_QCOM || COMPILE_TEST
	select QCOM_PAS
	select QCOM_TZMEM
	default y if ARCH_QCOM

config QCOM_TZMEM
	tristate
	select GENERIC_ALLOCATOR

config QCOM_TZMEM_MODE_SHMBRIDGE
	bool "TrustZone interface memory allocator: SHM Bridge"
	depends on QCOM_TZMEM
	help
	  Use Qualcomm Shared Memory Bridge as memory allocator. The memory has the
	  same alignment as in the 'Generic' allocator, which is used when this option
	  is disabled, but is also explicitly marked as an SHM Bridge buffer.

	  With this selected, all buffers passed to the TrustZone must be allocated
	  using the TZMem allocator or else the TrustZone will refuse to use them.

config QCOM_QSEECOM
	bool "Qualcomm QSEECOM interface driver"
	depends on QCOM_SCM=y
	select AUXILIARY_BUS
	help
	  Various Qualcomm SoCs have a Secure Execution Environment (SEE) running
	  in the Trust Zone. This module provides an interface to that via the
	  QSEECOM mechanism, using SCM calls.

	  The QSEECOM interface allows, among other things, access to applications
	  running in the SEE. An example of such an application is 'uefisecapp',
	  which is required to access UEFI variables on certain systems. If
	  selected, the interface will also attempt to detect and register client
	  devices for supported applications.

	  Select Y here to enable the QSEECOM interface driver.

config QCOM_QSEECOM_UEFISECAPP
	bool "Qualcomm SEE UEFI Secure App client driver"
	depends on QCOM_QSEECOM
	depends on EFI
	help
	  Various Qualcomm SoCs do not allow direct access to EFI variables.
	  Instead, these need to be accessed via the UEFI Secure Application
	  (uefisecapp), residing in the Secure Execution Environment (SEE).

	  This module provides a client driver for uefisecapp, installing efivar
	  operations to allow the kernel accessing EFI variables, and via that also
	  provide user-space with access to EFI variables via efivarfs.

	  Select Y here to provide access to EFI variables on the aforementioned
	  platforms.

config QCOM_TEE_UEFISECAPP
	tristate "Qualcomm TEE UEFI Secure App client driver"
	depends on QCOMTEE
	depends on EFI
	help
	  The QSEECOM protocol used for communicating with the Qualcomm Trusted
	  Execution Environment (QTEE) is deprecated and replaced with the SMCInvoke
	  protocol starting with the Qualcomm SM8x50 series. On platforms where the
	  QSEECOM protocol still works (the QSEECOM driver probes) the driver does
	  not support a listener interface with QTEE to enable writing of
	  non-volatile EFI variables (via listener requests to Linux) in the Replay
	  Protected Memory Block (RPMB) located on UFS/eMMC storage.
	  Therefore on such platforms, the TEE based uefisecapp client driver
	  (which communicates with QTEE via the SMCInvoke protocol) must be used
	  to update such EFI variables through the RPMB service hosted in the QTEE
	  supplicant user-space daemon (github.com/qualcomm/minkipc) which forwards
	  RPMB packets to the RPMB device.
	  NOTE: Qualcomm Compute platforms with SPI-NOR storage are an exception to
	  this scenario. Since they do not have a firmware running on their SPI-NOR
	  storage controller which must be programmed with a RPMB key, QTEE has a
	  SPI-NOR driver which holds the key, and so the QSEECOM driver can be used
	  for updating EFI variables on these platforms because QTEE never makes a
	  listener request to Linux (QTEE doesn't need the Linux SPI-NOR driver).

	  This module provides a TEE client driver for uefisecapp, installing efivar
	  operations to allow the kernel and user-space access to EFI variables.

	  Select m here to provide access to EFI variables on the aforementioned
	  platforms if your Linux distribution has QTEE supplicant installed and
	  running.

endmenu
```

## drivers/media/platform/qcom/camss/ope/Kconfig
```kconfig
config VIDEO_QCOM_CAMSS_OPE
	tristate "Qualcomm Offline Processing Engine (OPE) driver"
	depends on V4L_PLATFORM_DRIVERS
	depends on MEDIA_CONTROLLER
	depends on VIDEO_DEV
	depends on (ARCH_QCOM && IOMMU_DMA) || COMPILE_TEST
	select V4L2_ISP
	select VIDEOBUF2_DMA_CONTIG
	select VIDEOBUF2_VMALLOC
	help
	  Enable support for the Qualcomm Offline Processing Engine (OPE).
	  OPE is a memory-to-memory ISP block that converts raw Bayer frames
	  to YUV, performing white balance, demosaic, chroma enhancement and
	  downscaling. Found on QCM2290 and related SoCs.

	  To compile this driver as a module, choose M here: the module
	  will be called qcom-camss-ope.
```
