## Documentation/devicetree/bindings/net/bluetooth/qcom,qcc2072-bt.yaml
```yaml
# SPDX-License-Identifier: (GPL-2.0 OR BSD-2-Clause)
%YAML 1.2
---
$id: http://devicetree.org/schemas/net/bluetooth/qcom,qcc2072-bt.yaml#
$schema: http://devicetree.org/meta-schemas/core.yaml#

title: Qualcomm QCC2072 Bluetooth

maintainers:
  - Bartosz Golaszewski <brgl@bgdev.pl>
  - Balakrishna Godavarthi <quic_bgodavar@quicinc.com>
  - Rocky Liao <quic_rjliao@quicinc.com>

description:
  Qualcomm QCC2072 Bluetooth controller connected over UART.

  QCC2072 can be populated on an M.2 E-key card, where the card power
  supplies and sideband signals are modeled by the pcie-m2-e-connector node.
  The M.2 power sequencing provider creates the Bluetooth serdev device and
  uses this compatible after matching the QCC2072 PCI function.

  Integrated non-M.2 designs require board-specific power resources. Those
  properties, together with a static devicetree example, should be added when
  integrated non-M.2 support is added.

properties:
  compatible:
    enum:
      - qcom,qcc2072-bt

required:
  - compatible

allOf:
  - $ref: bluetooth-controller.yaml#
  - $ref: qcom,bluetooth-common.yaml
  - $ref: /schemas/serial/serial-peripheral-props.yaml#

unevaluatedProperties: false
```

## Documentation/devicetree/bindings/power/limits/power-limit-controller.yaml
```yaml
# SPDX-License-Identifier: (GPL-2.0-only OR BSD-2-Clause)
%YAML 1.2
---
$id: http://devicetree.org/schemas/power/limits/power-limit-controller.yaml#
$schema: http://devicetree.org/meta-schemas/core.yaml#

title: Power Limit Controller

maintainers:
  - Manaf Meethalavalappu Pallikunhi <manaf.pallikunhi@oss.qualcomm.com>

description:
  Power limit controllers are hardware blocks that enforce power consumption
  limits on SoC power domains to prevent thermal overload, maintain system
  stability, and comply with platform power budgets.

  These controllers typically provide
    - Hardware-enforced power capping for one or more power domains
    - Configurable power limits (e.g., sustained, burst, peak)
    - Time window controls for power averaging
    - Energy or power monitoring and reporting capabilities
    - Power balancing algorithms across domains

  This binding describes the common properties for power limit controller
  provider nodes. Individual controller bindings should reference this schema
  and add device-specific properties.

select: false

properties:
  $nodename:
    pattern: "^power-limits(@.*)?$"

additionalProperties: true
```

## Documentation/devicetree/bindings/power/limits/qcom,glymur-spel.yaml
```yaml
# SPDX-License-Identifier: (GPL-2.0-only OR BSD-2-Clause)
%YAML 1.2
---
$id: http://devicetree.org/schemas/power/limits/qcom,glymur-spel.yaml#
$schema: http://devicetree.org/meta-schemas/core.yaml#

title: Qualcomm Glymur SoC Power and Electrical Limits (SPEL)

maintainers:
  - Manaf Meethalavalappu Pallikunhi <manaf.pallikunhi@oss.qualcomm.com>

description:
  The Qualcomm SPEL (SoC Power and Electrical Limits) is a hardware block that
  provides power monitoring and limiting capabilities for various power domains
  in Qualcomm SoCs.

  SPEL enforces power consumption limits to prevent thermal overload, maintain
  system stability, and comply with platform power budgets. It provides
    - Hardware-enforced power capping with configurable power limits
    - Time window controls for power averaging
    - Energy counter monitoring for each power domain
    - Automatic throttling when power limits are exceeded

  The hardware supports multiple power domains including system (SYS), SoC,
  CPU clusters, GPU, memory, and peripheral subsystems. Each domain can have
  independent power limits and monitoring.

allOf:
  - $ref: power-limit-controller.yaml#

properties:
  compatible:
    const: qcom,glymur-spel

  reg:
    maxItems: 3

  reg-names:
    items:
      - const: config
      - const: constraints
      - const: nodes

required:
  - compatible
  - reg
  - reg-names

unevaluatedProperties: false

examples:
  - |
    power-limits@ef3b000 {
        compatible = "qcom,glymur-spel";
        reg = <0x0ef3b000 0x1000>,
              <0x0ef3d000 0x1000>,
              <0x0ef3e000 0x1000>;
        reg-names = "config",
                    "constraints",
                    "nodes";
    };
```

## Documentation/devicetree/bindings/soc/qcom/qcom,eud.yaml
```yaml
# SPDX-License-Identifier: (GPL-2.0 OR BSD-2-Clause)
%YAML 1.2
---
$id: http://devicetree.org/schemas/soc/qcom/qcom,eud.yaml#
$schema: http://devicetree.org/meta-schemas/core.yaml#

title: Qualcomm Embedded USB Debugger

maintainers:
  - Souradeep Chowdhury <quic_schowdhu@quicinc.com>

description:
  This binding is used to describe the Qualcomm Embedded USB Debugger, which is
  mini USB-hub implemented on chip to support USB-based debug capabilities.

properties:
  compatible:
    items:
      - enum:
          - qcom,sc7280-eud
          - qcom,sm8350-eud
      - const: qcom,eud

  reg:
    items:
      - description: EUD Base Register Region
      - description: EUD Mode Manager Register

  interrupts:
    description: EUD interrupt
    maxItems: 1

  ports:
    $ref: /schemas/graph.yaml#/properties/ports
    description:
      These ports is to be attached to the endpoint of the DWC3 controller node
      and type C connector node. The controller has the "usb-role-switch"
      property.

    properties:
      port@0:
        $ref: /schemas/graph.yaml#/properties/port
        description: This port is to be attached to the DWC3 controller.

      port@1:
        $ref: /schemas/graph.yaml#/properties/port
        description: This port is to be attached to the type C connector.

  '#address-cells':
    const: 1

  '#size-cells':
    const: 0

patternProperties:
  "^eud-path@[0-1]$":
    type: object
    description:
      Represents one High-Speed UTMI path that EUD intercepts. Use eud-path nodes
      to associate role-switching behavior with specific port connections, allowing
      EUD to manage role transitions independently for each UTMI path.

    properties:
      reg:
        maxItems: 1
        description: Path number

      usb-role-switch:
        type: boolean
        description:
          Indicates that EUD relays USB role-switch events for this path and
          performs role-dependent UTMI routing accordingly. In device role,
          the EUD hub is inserted into this path to enable debug
          functionality. In host role, the EUD hub is bypassed and UTMI
          traffic flows directly between the PHY and the USB controller.

      ports:
        $ref: /schemas/graph.yaml#/properties/ports
        description:
          These ports are to be attached to the endpoint of the USB controller node
          and USB connector node.

        properties:
          port@0:
            $ref: /schemas/graph.yaml#/properties/port
            description: This port is to be attached to the USB controller.

          port@1:
            $ref: /schemas/graph.yaml#/properties/port
            description: This port is to be attached to the USB connector.

    required:
      - reg
      - ports

    additionalProperties: false

required:
  - compatible
  - reg

allOf:
  - if:
      properties:
        compatible:
          contains:
            const: qcom,sc7280-eud
    then:
      oneOf:
        - required:
            - ports
          properties:
            eud-path@0: false
            eud-path@1: false
        - required:
            - eud-path@0
            - '#address-cells'
            - '#size-cells'
          properties:
            ports: false
            eud-path@1: false
  - if:
      properties:
        compatible:
          contains:
            const: qcom,sm8350-eud
    then:
      required:
        - eud-path@0
        - eud-path@1
        - '#address-cells'
        - '#size-cells'
      properties:
        ports: false

additionalProperties: false

examples:
  - |
    eud@88e0000 {
        compatible = "qcom,sc7280-eud", "qcom,eud";
        reg = <0x88e0000 0x2000>,
              <0x88e2000 0x1000>;

        ports {
            #address-cells = <1>;
            #size-cells = <0>;
            port@0 {
                reg = <0>;
                eud_ep: endpoint {
                    remote-endpoint = <&usb2_role_switch>;
                };
            };

            port@1 {
                reg = <1>;
                eud_con: endpoint {
                    remote-endpoint = <&con_eud>;
                };
            };
        };
    };
  - |
    eud@88e0000 {
        compatible = "qcom,sm8350-eud", "qcom,eud";
        reg = <0x88e0000 0x2000>,
              <0x88e2000 0x1000>;
        #address-cells = <1>;
        #size-cells = <0>;

        eud-path@0 {
            reg = <0>;
            usb-role-switch;

            ports {
                #address-cells = <1>;
                #size-cells = <0>;
                port@0 {
                    reg = <0>;
                    eud_usb0: endpoint {
                        remote-endpoint = <&usb_1_dwc3_hs>;
                    };
                };

                port@1 {
                    reg = <1>;
                    eud_con0: endpoint {
                        remote-endpoint = <&pmic_glink_hs_in>;
                    };
                };
            };
        };

        eud-path@1 {
            reg = <1>;

            ports {
                #address-cells = <1>;
                #size-cells = <0>;
                port@0 {
                    reg = <0>;
                    eud_usb1: endpoint {
                        remote-endpoint = <&usb_2_dwc3_hs>;
                    };
                };

                port@1 {
                    reg = <1>;
                    eud_con1: endpoint {
                        remote-endpoint = <&conn_2_hs_in>;
                    };
                };
            };
        };
    };
```

## Documentation/devicetree/bindings/usb/qcom,sa8255p-dwc3.yaml
```yaml
# SPDX-License-Identifier: (GPL-2.0 OR BSD-2-Clause)
%YAML 1.2
---
$id: http://devicetree.org/schemas/usb/qcom,sa8255p-dwc3.yaml#
$schema: http://devicetree.org/meta-schemas/core.yaml#

title: Qualcomm SA8255P USB3 Controller with Firmware-Managed Resources

maintainers:
  - Wesley Cheng <wesley.cheng@oss.qualcomm.com>
  - Faisal Hassan <faisal.hassan@oss.qualcomm.com>

description:
  USB controller on Qualcomm SA8255P automotive SoC where platform resources
  such as clocks, interconnects, resets, regulators and the GDSC are
  abstracted and managed collectively by firmware through SCMI (System
  Control and Management Interface).

  Access to these firmware-managed resources is exposed as two power
  domains, one gating the power supply (GDSC) to the controller, and one
  gating the clocks and interconnects used for data transfer.
  Both are SCMI power domains that are only switched on and off, and
  neither carries performance levels.

properties:
  compatible:
    const: qcom,sa8255p-dwc3

  reg:
    maxItems: 1

  interrupts:
    maxItems: 6

  interrupt-names:
    items:
      - const: dwc_usb3
      - const: pwr_event
      - const: hs_phy_irq
      - const: dp_hs_phy_irq
      - const: dm_hs_phy_irq
      - const: ss_phy_irq

  power-domains:
    maxItems: 2

  power-domain-names:
    items:
      - const: power
      - const: bus

  resets:
    maxItems: 1

  iommus:
    maxItems: 1

  phys:
    maxItems: 2

  phy-names:
    items:
      - const: usb2-phy
      - const: usb3-phy

  dma-coherent: true

required:
  - compatible
  - reg
  - interrupts
  - interrupt-names
  - power-domains
  - power-domain-names
  - resets
  - phys
  - phy-names

allOf:
  - $ref: snps,dwc3-common.yaml#

unevaluatedProperties: false

examples:
  - |
    #include <dt-bindings/interrupt-controller/arm-gic.h>
    #include <dt-bindings/interrupt-controller/irq.h>

    usb@a800000 {
        compatible = "qcom,sa8255p-dwc3";
        reg = <0x0a800000 0x10000>;

        interrupts-extended = <&intc GIC_SPI 349 IRQ_TYPE_LEVEL_HIGH>,
                              <&intc GIC_SPI 352 IRQ_TYPE_LEVEL_HIGH>,
                              <&intc GIC_SPI 351 IRQ_TYPE_LEVEL_HIGH>,
                              <&pdc 8 IRQ_TYPE_EDGE_BOTH>,
                              <&pdc 7 IRQ_TYPE_EDGE_BOTH>,
                              <&pdc 13 IRQ_TYPE_LEVEL_HIGH>;
        interrupt-names = "dwc_usb3",
                          "pwr_event",
                          "hs_phy_irq",
                          "dp_hs_phy_irq",
                          "dm_hs_phy_irq",
                          "ss_phy_irq";

        power-domains = <&scmi_pd 1>, <&scmi_pd 2>;
        power-domain-names = "power", "bus";
        resets = <&scmi_rst 0>;

        iommus = <&apps_smmu 0x0a0 0x0>;
        phys = <&usb_1_hsphy>, <&usb_1_qmpphy>;
        phy-names = "usb2-phy", "usb3-phy";
    };
...
```

## drivers/firmware/psci/Kconfig
```kconfig
# SPDX-License-Identifier: GPL-2.0-only
config ARM_PSCI_FW
	bool

config ARM_PSCI_DEVICES
	bool "PSCI auxiliary device support"
	depends on ARM_PSCI_FW
	depends on OF
	select AUXILIARY_BUS
	default y
	help
	  Say Y here to enable auxiliary device support for PSCI.

	  This creates auxiliary devices for PSCI functionality implemented
	  outside the core PSCI firmware driver. These devices allow PSCI
	  child drivers to bind through the auxiliary bus while sharing the
	  PSCI firmware device as their parent.

config ARM_PSCI_CHECKER
	bool "ARM PSCI checker"
	depends on ARM_PSCI_FW && HOTPLUG_CPU && CPU_IDLE && !TORTURE_TEST
	help
	  Run the PSCI checker during startup. This checks that hotplug and
	  suspend operations work correctly when using PSCI.

	  The torture tests may interfere with the PSCI checker by turning CPUs
	  on and off through hotplug, so for now torture tests and PSCI checker
	  are mutually exclusive.
```
