## Documentation/devicetree/bindings/firmware/qcom,generic-scmi.yaml
```yaml
# SPDX-License-Identifier: (GPL-2.0 OR BSD-2-Clause)
%YAML 1.2
---
$id: http://devicetree.org/schemas/firmware/qcom,generic-scmi.yaml#
$schema: http://devicetree.org/meta-schemas/core.yaml#

title: System Control and Management Interface (SCMI) Qualcomm Generic Extension Protocol

maintainers:
  - Pragnesh Papaniya <pragnesh.papaniya@oss.qualcomm.com>
  - Sibi Sankar <sibi.sankar@oss.qualcomm.com>

properties:
  protocol@80:
    description:
      SCMI Qualcomm Generic Extension Protocol exposes Qualcomm SoC specific
      algorithms such as Memory Latency (MEMLAT) bound DDR/LLCC/DDR-QOS bus DVFS.
      The algorithm runs on the SCP, it can be turned on/off and be configured
      through a pairing of algorithm strings with an immutable list param_ids.
    $ref: '/schemas/firmware/arm,scmi.yaml#/$defs/protocol-node'
    unevaluatedProperties: false

    properties:
      reg:
        const: 0x80

additionalProperties: true
```

## Documentation/devicetree/bindings/hwmon/qcom,pm7250b-bcl.yaml
```yaml
# SPDX-License-Identifier: (GPL-2.0-only OR BSD-2-Clause)
%YAML 1.2
---
$id: http://devicetree.org/schemas/hwmon/qcom,pm7250b-bcl.yaml#
$schema: http://devicetree.org/meta-schemas/core.yaml#

title: Qualcomm SPMI PMIC Battery Current Limiting (BCL) Hardware Monitor

maintainers:
  - Manaf Meethalavalappu Pallikunhi <manaf.pallikunhi@oss.qualcomm.com>

description:
  SPMI PMIC Battery Current Limiting (BCL) hardware provides monitoring and
  alarm functionality for battery overcurrent and battery or system under
  voltage conditions. It monitors battery voltage and current, and
  can trigger interrupts when configurable thresholds are exceeded.

properties:
  compatible:
    enum:
      - qcom,pm7250b-bcl
      - qcom,pm7550-bcl
      - qcom,pm7550ba-bcl
      - qcom,pm8350c-bcl
      - qcom,pm8550-bcl
      - qcom,pmh0101-bcl
      - qcom,pmih0108-bcl
      - qcom,smb2360-bcl
      - qcom,smb2370-bcl

  reg:
    maxItems: 1

  interrupts:
    maxItems: 3

  interrupt-names:
    items:
      - const: max-min
      - const: critical
      - const: emergency

required:
  - compatible
  - reg
  - interrupts
  - interrupt-names

additionalProperties: false

examples:
  - |
    #include <dt-bindings/interrupt-controller/irq.h>

    pmic {
        #address-cells = <1>;
        #size-cells = <0>;

        sensor@1d00 {
            compatible = "qcom,pm7250b-bcl";
            reg = <0x1d00>;
            interrupts = <0x2 0x1d 0x0 IRQ_TYPE_EDGE_RISING>,
                         <0x2 0x1d 0x1 IRQ_TYPE_EDGE_RISING>,
                         <0x2 0x1d 0x2 IRQ_TYPE_EDGE_RISING>;
            interrupt-names = "max-min",
                              "critical",
                              "emergency";
        };
    };
```

## Documentation/devicetree/bindings/media/i2c/himax,hm1092.yaml
```yaml
# SPDX-License-Identifier: (GPL-2.0 OR BSD-2-Clause)
%YAML 1.2
---
$id: http://devicetree.org/schemas/media/i2c/himax,hm1092.yaml#
$schema: http://devicetree.org/meta-schemas/core.yaml#

title: Himax HM1092 Monochrome NIR Sensor

maintainers:
  - Ramshouriesh R <rshouriesh@gmail.com>

description:
  The Himax HM1092 is a 1 megapixel monochrome near-infrared CMOS image
  sensor with a MIPI CSI-2 interface, commonly used as the IR camera for
  face authentication on laptops. It outputs 10-bit RAW over a single
  MIPI CSI-2 data lane.

allOf:
  - $ref: /schemas/media/video-interface-devices.yaml#

properties:
  compatible:
    const: himax,hm1092

  reg:
    maxItems: 1

  clocks:
    maxItems: 1

  avdd-supply:
    description: Analogue circuit voltage supply.

  dovdd-supply:
    description: I/O circuit voltage supply.

  dvdd-supply:
    description: Digital circuit voltage supply.

  reset-gpios:
    maxItems: 1
    description: Active low GPIO connected to the XSHUTDOWN pad.

  port:
    $ref: /schemas/graph.yaml#/$defs/port-base
    additionalProperties: false

    properties:
      endpoint:
        $ref: /schemas/media/video-interfaces.yaml#
        unevaluatedProperties: false

        required:
          - link-frequencies

required:
  - compatible
  - reg
  - clocks
  - avdd-supply
  - dovdd-supply
  - dvdd-supply
  - port

unevaluatedProperties: false

examples:
  - |
    #include <dt-bindings/gpio/gpio.h>

    i2c {
        #address-cells = <1>;
        #size-cells = <0>;

        camera@24 {
            compatible = "himax,hm1092";
            reg = <0x24>;

            reset-gpios = <&tlmm 109 GPIO_ACTIVE_LOW>;
            pinctrl-names = "default";
            pinctrl-0 = <&cam_ir_default>;

            clocks = <&camcc 1>;
            assigned-clocks = <&camcc 1>;
            assigned-clock-rates = <24000000>;

            orientation = <0>;

            avdd-supply = <&vreg_l7m_2p9>;
            dvdd-supply = <&vreg_l7m_2p9>;
            dovdd-supply = <&vreg_l4m_1p8>;

            port {
                hm1092_ep: endpoint {
                    link-frequencies = /bits/ 64 <180000000>;
                    remote-endpoint = <&camss_csiphy0_inep>;
                };
            };
        };
    };
...
```

## Documentation/devicetree/bindings/media/qcom,glymur-iris.yaml
```yaml
# SPDX-License-Identifier: (GPL-2.0-only OR BSD-2-Clause)
%YAML 1.2
---
$id: http://devicetree.org/schemas/media/qcom,glymur-iris.yaml#
$schema: http://devicetree.org/meta-schemas/core.yaml#

title: Qualcomm Glymur SoC Iris video encoder and decoder

maintainers:
  - Vishnu Reddy <busanna.reddy@oss.qualcomm.com>

description:
  The Iris video processing unit on Qualcomm Glymur SoC is a video encode and
  decode accelerator.

properties:
  compatible:
    const: qcom,glymur-iris

  clocks:
    maxItems: 9

  clock-names:
    items:
      - const: core_iface
      - const: core
      - const: vcodec0_core
      - const: vcodec0_iface
      - const: core_freerun
      - const: vcodec0_core_freerun
      - const: vcodec1_iface
      - const: vcodec1_core
      - const: vcodec1_core_freerun

  dma-coherent: true

  interconnects:
    maxItems: 2

  interconnect-names:
    items:
      - const: cpu-cfg
      - const: video-mem

  '#address-cells':
    const: 2

  '#size-cells':
    const: 2

  non-pixel:
    type: object
    description:
      Context bank for VPU non-pixel buffers, including compressed and internal buffers.
    properties:
      iommus:
        maxItems: 3
      memory-region:
        maxItems: 1
    required:
      - iommus
      - memory-region
    additionalProperties: false

  pixel:
    type: object
    description:
      Context bank for VPU pixel buffers containing uncompressed video data.
    properties:
      iommus:
        maxItems: 1
    required:
      - iommus
    additionalProperties: false

  video-firmware:
    type: object
    description:
      Context bank for the VPU firmware processing domain.
    properties:
      iommus:
        maxItems: 1
    required:
      - iommus
    additionalProperties: false

  operating-points-v2: true
  opp-table:
    type: object

  power-domains:
    maxItems: 5

  power-domain-names:
    items:
      - const: venus
      - const: vcodec0
      - const: mxc
      - const: mmcx
      - const: vcodec1

  resets:
    maxItems: 6

  reset-names:
    items:
      - const: core_bus
      - const: vcodec0_bus
      - const: core
      - const: vcodec0_core
      - const: vcodec1_bus
      - const: vcodec1_core

required:
  - clocks
  - clock-names
  - compatible
  - dma-coherent
  - interconnects
  - interconnect-names
  - "#address-cells"
  - "#size-cells"
  - non-pixel
  - pixel
  - power-domains
  - power-domain-names
  - resets
  - reset-names

allOf:
  - $ref: qcom,venus-common.yaml#

unevaluatedProperties: false

examples:
  - |
    #include <dt-bindings/interrupt-controller/arm-gic.h>
    #include <dt-bindings/power/qcom,rpmhpd.h>

    video-codec@aa00000 {
        compatible = "qcom,glymur-iris";
        reg = <0x0aa00000 0xf0000>;

        clocks = <&gcc_video_axi0c_clk>,
                 <&videocc_mvs0c_clk>,
                 <&videocc_mvs0_clk>,
                 <&gcc_video_axi0_clk>,
                 <&videocc_mvs0c_freerun_clk>,
                 <&videocc_mvs0_freerun_clk>,
                 <&gcc_video_axi1_clk>,
                 <&videocc_mvs1_clk>,
                 <&videocc_mvs1_freerun_clk>;
        clock-names = "core_iface",
                      "core",
                      "vcodec0_core",
                      "vcodec0_iface",
                      "core_freerun",
                      "vcodec0_core_freerun",
                      "vcodec1_iface",
                      "vcodec1_core",
                      "vcodec1_core_freerun";

        dma-coherent;

        interconnects = <&hsc_noc_master_appss_proc &config_noc_slave_venus_cfg>,
                        <&mmss_noc_master_video &mc_virt_slave_ebi1>;
        interconnect-names = "cpu-cfg",
                             "video-mem";

        interrupts = <GIC_SPI 174 IRQ_TYPE_LEVEL_HIGH>;

        memory-region = <&video_mem>;

        operating-points-v2 = <&iris_opp_table>;

        power-domains = <&videocc_mvs0c_gdsc>,
                        <&videocc_mvs0_gdsc>,
                        <&rpmhpd RPMHPD_MXC>,
                        <&rpmhpd RPMHPD_MMCX>,
                        <&videocc_mvs1_gdsc>;
        power-domain-names = "venus",
                             "vcodec0",
                             "mxc",
                             "mmcx",
                             "vcodec1";

        resets = <&gcc_video_axi0c_clk_ares>,
                 <&gcc_video_axi0_clk_ares>,
                 <&videocc_mvs0c_freerun_clk_ares>,
                 <&videocc_mvs0_freerun_clk_ares>,
                 <&gcc_video_axi1_clk_ares>,
                 <&videocc_mvs1_freerun_clk_ares>;
        reset-names = "core_bus",
                      "vcodec0_bus",
                      "core",
                      "vcodec0_core",
                      "vcodec1_bus",
                      "vcodec1_core";

        #address-cells = <2>;
        #size-cells = <2>;

        non-pixel {
            iommus = <&apps_smmu 0x1940 0x0000>,
                     <&apps_smmu 0x1944 0x0000>,
                     <&apps_smmu 0x19e0 0x0000>;
            memory-region = <&iris_resv>;
        };

        pixel {
            iommus = <&apps_smmu 0x1943 0x0000>;
        };

        video-firmware {
            iommus = <&apps_smmu 0x19e2 0x0000>;
        };

        iris_opp_table: opp-table {
            compatible = "operating-points-v2";

            opp-240000000 {
                opp-hz = /bits/ 64 <240000000 240000000 360000000>;
                required-opps = <&rpmhpd_opp_svs>,
                                <&rpmhpd_opp_low_svs>;
            };

            opp-338000000 {
                opp-hz = /bits/ 64 <338000000 338000000 507000000>;
                required-opps = <&rpmhpd_opp_svs>,
                                <&rpmhpd_opp_svs>;
            };

            opp-366000000 {
                opp-hz = /bits/ 64 <366000000 366000000 549000000>;
                required-opps = <&rpmhpd_opp_svs_l1>,
                                <&rpmhpd_opp_svs_l1>;
            };

            opp-444000000 {
                opp-hz = /bits/ 64 <444000000 444000000 666000000>;
                required-opps = <&rpmhpd_opp_svs_l1>,
                                <&rpmhpd_opp_nom>;
            };

            opp-533333334 {
                opp-hz = /bits/ 64 <533333334 533333334 800000000>;
                required-opps = <&rpmhpd_opp_svs_l1>,
                                <&rpmhpd_opp_turbo>;
            };

            opp-655000000 {
                opp-hz = /bits/ 64 <655000000 655000000 982000000>;
                required-opps = <&rpmhpd_opp_nom>,
                                <&rpmhpd_opp_turbo_l1>;
            };
        };
    };
```

## Documentation/devicetree/bindings/media/qcom,qcm2290-camss-ope.yaml
```yaml
# SPDX-License-Identifier: (GPL-2.0 OR BSD-2-Clause)
%YAML 1.2
---
$id: http://devicetree.org/schemas/media/qcom,qcm2290-camss-ope.yaml#
$schema: http://devicetree.org/meta-schemas/core.yaml#

title: Qualcomm Camera Subsystem Offline Processing Engine

maintainers:
  - Loic Poulain <loic.poulain@oss.qualcomm.com>

description:
  The Qualcomm Camera Subsystem (CAMSS) Offline Processing Engine (OPE)
  is a memory-to-memory image processing block. It supports a range of
  pixel-processing operations such as scaling, cropping, gain adjustments,
  white-balancing, and various format conversions. The OPE does not
  interface directly with image sensors, instead, it processes frames
  sourced from and written back to system memory.

properties:
  compatible:
    const: qcom,qcm2290-camss-ope

  reg:
    maxItems: 6

  reg-names:
    items:
      - const: cdm
      - const: top
      - const: qos
      - const: pipeline
      - const: bus_read
      - const: bus_write

  clocks:
    maxItems: 5

  clock-names:
    items:
      - const: axi
      - const: core
      - const: iface
      - const: nrt
      - const: top

  interrupts:
    maxItems: 1

  interconnects:
    maxItems: 2

  interconnect-names:
    items:
      - const: config
      - const: data

  iommus:
    items:
      - description: OPE CDM (Configuration DMA) port.
      - description: OPE read (fetch engine) port.
      - description: OPE write (write engine) port.

  operating-points-v2: true

  opp-table:
    type: object

  power-domains:
    items:
      - description: GDSC CAMSS Block, Global Distributed Switch Controller.
      - description: CX power domain.

  power-domain-names:
    items:
      - const: camss
      - const: cx

required:
  - compatible
  - reg
  - reg-names
  - clocks
  - clock-names
  - interrupts
  - interconnects
  - interconnect-names
  - iommus
  - power-domains
  - power-domain-names

additionalProperties: false

examples:
  - |
    #include <dt-bindings/clock/qcom,gcc-qcm2290.h>
    #include <dt-bindings/interconnect/qcom,qcm2290.h>
    #include <dt-bindings/interconnect/qcom,rpm-icc.h>
    #include <dt-bindings/interrupt-controller/arm-gic.h>
    #include <dt-bindings/power/qcom-rpmpd.h>

    camss_ope: isp@5c42000 {
        compatible = "qcom,qcm2290-camss-ope";

        reg = <0x5c42000 0x400>,
              <0x5c42400 0x200>,
              <0x5c42600 0x200>,
              <0x5c42800 0x4400>,
              <0x5c46c00 0x190>,
              <0x5c46d90 0xa00>;
        reg-names = "cdm", "top", "qos", "pipeline",
                    "bus_read", "bus_write";

        clocks = <&gcc GCC_CAMSS_AXI_CLK>,
                 <&gcc GCC_CAMSS_OPE_CLK>,
                 <&gcc GCC_CAMSS_OPE_AHB_CLK>,
                 <&gcc GCC_CAMSS_NRT_AXI_CLK>,
                 <&gcc GCC_CAMSS_TOP_AHB_CLK>;
        clock-names = "axi", "core", "iface", "nrt", "top";

        interrupts = <GIC_SPI 209 IRQ_TYPE_EDGE_RISING>;

        interconnects = <&bimc MASTER_APPSS_PROC RPM_ACTIVE_TAG
                         &config_noc SLAVE_CAMERA_CFG RPM_ACTIVE_TAG>,
                        <&mmnrt_virt MASTER_CAMNOC_SF RPM_ALWAYS_TAG
                         &bimc SLAVE_EBI1 RPM_ALWAYS_TAG>;
        interconnect-names = "config", "data";

        iommus = <&apps_smmu 0x800 0x0>,
                 <&apps_smmu 0x820 0x0>,
                 <&apps_smmu 0x840 0x0>;

        operating-points-v2 = <&ope_opp_table>;
        power-domains = <&gcc GCC_CAMSS_TOP_GDSC>,
                         <&rpmpd QCM2290_VDDCX>;
        power-domain-names = "camss", "cx";

        ope_opp_table: opp-table {
            compatible = "operating-points-v2";

            opp-200000000 {
                opp-hz = /bits/ 64 <200000000>;
                required-opps = <&rpmpd_opp_svs>;
            };

            opp-465000000 {
                opp-hz = /bits/ 64 <465000000>;
                required-opps = <&rpmpd_opp_nom>;
            };
        };
    };
```
