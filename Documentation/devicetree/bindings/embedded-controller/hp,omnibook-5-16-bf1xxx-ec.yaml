## Documentation/devicetree/bindings/embedded-controller/hp,omnibook-5-16-bf1xxx-ec.yaml
```yaml
# SPDX-License-Identifier: (GPL-2.0-only OR BSD-2-Clause)
%YAML 1.2
---
$id: http://devicetree.org/schemas/embedded-controller/hp,omnibook-5-16-bf1xxx-ec.yaml#
$schema: http://devicetree.org/meta-schemas/core.yaml#

title: HP OmniBook 5 16 Embedded Controller

maintainers:
  - Rahul Pon <theflyingrahul@gmail.com>

description:
  The embedded controller of the HP OmniBook 5 16 (Snapdragon X2), on an
  I2C bus. It runs the fan and the keyboard backlight and reports the fan
  speed and its thermistor temperatures. Its four thermistors can serve
  as thermal sensors, indexed 0 to 3.

properties:
  compatible:
    const: hp,omnibook-5-16-bf1xxx-ec

  reg:
    const: 0x76

  interrupts:
    maxItems: 1

  "#thermal-sensor-cells":
    const: 1

required:
  - compatible
  - reg

additionalProperties: false

examples:
  - |
    i2c {
        #address-cells = <1>;
        #size-cells = <0>;

        embedded-controller@76 {
            compatible = "hp,omnibook-5-16-bf1xxx-ec";
            reg = <0x76>;
            #thermal-sensor-cells = <1>;
        };
    };
...
```
