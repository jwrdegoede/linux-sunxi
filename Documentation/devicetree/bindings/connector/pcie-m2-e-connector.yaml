## Documentation/devicetree/bindings/connector/pcie-m2-e-connector.yaml
```yaml
# SPDX-License-Identifier: (GPL-2.0-only OR BSD-2-Clause)
%YAML 1.2
---
$id: http://devicetree.org/schemas/connector/pcie-m2-e-connector.yaml#
$schema: http://devicetree.org/meta-schemas/core.yaml#

title: PCIe M.2 Mechanical Key E Connector

maintainers:
  - Manivannan Sadhasivam <manivannan.sadhasivam@oss.qualcomm.com>

description:
  A PCIe M.2 E connector node represents a physical PCIe M.2 Mechanical Key E
  connector. Mechanical Key E connectors are used to connect Wireless
  Connectivity devices including combinations of Wi-Fi, BT, NFC to the host
  machine over interfaces like PCIe/SDIO, USB/UART+PCM, and I2C.

properties:
  compatible:
    const: pcie-m2-e-connector

  vpcie3v3-supply:
    description: A phandle to the regulator for 3.3v supply.

  vpcie1v8-supply:
    description: A phandle to the regulator for VIO 1.8v supply.

  ports:
    $ref: /schemas/graph.yaml#/properties/ports
    description: OF graph bindings modeling the interfaces exposed on the
      connector. Since a single connector can have multiple interfaces, every
      interface has an assigned OF graph port number as described below.

    properties:
      port@0:
        $ref: /schemas/graph.yaml#/properties/port
        description: Connector interfaces for Wi-Fi

        properties:
          endpoint@0:
            $ref: /schemas/graph.yaml#/properties/endpoint
            description: PCIe interface

          endpoint@1:
            $ref: /schemas/graph.yaml#/properties/endpoint
            description: SDIO interface

        anyOf:
          - required:
              - endpoint@0
          - required:
              - endpoint@1

      port@1:
        $ref: /schemas/graph.yaml#/properties/port
        description: Connector interfaces for BT

        properties:
          endpoint@0:
            $ref: /schemas/graph.yaml#/properties/endpoint
            description: USB 2.0 interface

          endpoint@1:
            $ref: /schemas/graph.yaml#/properties/endpoint
            description: UART interface

        anyOf:
          - required:
              - endpoint@0
          - required:
              - endpoint@1

      port@2:
        $ref: /schemas/graph.yaml#/properties/port
        description: PCM/I2S interface

      i2c-parent:
        $ref: /schemas/types.yaml#/definitions/phandle
        description: I2C interface

    oneOf:
      - required:
          - port@0

  clocks:
    description: 32.768 KHz Suspend Clock (SUSCLK) input from the host system to
      the M.2 card. Refer, PCI Express M.2 Specification r4.0, sec 3.1.12.1 for
      more details.
    maxItems: 1

  w-disable1-gpios:
    description: GPIO input to W_DISABLE1# signal. This signal is used by the
      system to disable WiFi radio in the M.2 card. Refer, PCI Express M.2
      Specification r4.0, sec 3.1.12.3 for more details.
    maxItems: 1

  w-disable2-gpios:
    description: GPIO input to W_DISABLE2# signal. This signal is used by the
      system to disable WiFi radio in the M.2 card. Refer, PCI Express M.2
      Specification r4.0, sec 3.1.12.3 for more details.
    maxItems: 1

  viocfg-gpios:
    description: GPIO output to IO voltage configuration (VIO_CFG) signal. This
      signal is used by the M.2 card to indicate to the host system that the
      card supports an independent IO voltage domain for the sideband signals.
      Refer, PCI Express M.2 Specification r4.0, sec 3.1.15.1 for more details.
    maxItems: 1

required:
  - compatible
  - vpcie3v3-supply

additionalProperties: false

examples:
  # PCI M.2 Key E connector for Wi-Fi/BT with PCIe/UART interfaces
  - |
    #include <dt-bindings/gpio/gpio.h>

    connector {
        compatible = "pcie-m2-e-connector";
        vpcie3v3-supply = <&vreg_wcn_3p3>;
        vpcie1v8-supply = <&vreg_l15b_1p8>;
        w-disable1-gpios = <&tlmm 117 GPIO_ACTIVE_LOW>;
        w-disable2-gpios = <&tlmm 116 GPIO_ACTIVE_LOW>;

        ports {
            #address-cells = <1>;
            #size-cells = <0>;

            port@0 {
                reg = <0>;
                #address-cells = <1>;
                #size-cells = <0>;

                endpoint@0 {
                    reg = <0>;
                    remote-endpoint = <&pcie4_port0_ep>;
                };
            };

            port@1 {
                reg = <1>;
                #address-cells = <1>;
                #size-cells = <0>;

                endpoint@1 {
                    reg = <1>;
                    remote-endpoint = <&uart14_ep>;
                };
            };
        };
    };
```

## Documentation/devicetree/bindings/connector/pcie-m2-m-connector.yaml
```yaml
# SPDX-License-Identifier: (GPL-2.0-only OR BSD-2-Clause)
%YAML 1.2
---
$id: http://devicetree.org/schemas/connector/pcie-m2-m-connector.yaml#
$schema: http://devicetree.org/meta-schemas/core.yaml#

title: PCIe M.2 Mechanical Key M Connector

maintainers:
  - Manivannan Sadhasivam <manivannan.sadhasivam@oss.qualcomm.com>

description:
  A PCIe M.2 M connector node represents a physical PCIe M.2 Mechanical Key M
  connector. The Mechanical Key M connectors are used to connect SSDs to the
  host system over PCIe/SATA interfaces. These connectors also offer optional
  interfaces like USB, SMBus.

properties:
  compatible:
    const: pcie-m2-m-connector

  vpcie3v3-supply:
    description: A phandle to the regulator for 3.3v supply.

  vpcie1v8-supply:
    description: A phandle to the regulator for VIO 1.8v supply.

  ports:
    $ref: /schemas/graph.yaml#/properties/ports
    description: OF graph bindings modeling the interfaces exposed on the
      connector. Since a single connector can have multiple interfaces, every
      interface has an assigned OF graph port number as described below.

    properties:
      port@0:
        $ref: /schemas/graph.yaml#/properties/port
        description: Host interfaces of the connector

        properties:
          endpoint@0:
            $ref: /schemas/graph.yaml#/properties/endpoint
            description: PCIe interface

          endpoint@1:
            $ref: /schemas/graph.yaml#/properties/endpoint
            description: SATA interface

        anyOf:
          - required:
              - endpoint@0
          - required:
              - endpoint@1

      port@1:
        $ref: /schemas/graph.yaml#/properties/port
        description: USB 2.0 interface

      i2c-parent:
        $ref: /schemas/types.yaml#/definitions/phandle
        description: SMBus interface

    required:
      - port@0

  clocks:
    description: 32.768 KHz Suspend Clock (SUSCLK) input from the host system to
      the M.2 card. Refer, PCI Express M.2 Specification r4.0, sec 3.1.12.1 for
      more details.
    maxItems: 1

  pedet-gpios:
    description: GPIO input to PEDET signal. This signal is used by the host
      systems to determine the communication protocol that the M.2 card uses;
      SATA signaling (low) or PCIe signaling (high). Refer, PCI Express M.2
      Specification r4.0, sec 3.3.4.2 for more details.
    maxItems: 1

  viocfg-gpios:
    description: GPIO output to IO voltage configuration (VIO_CFG) signal. This
      signal is used by the M.2 card to indicate to the host system that the
      card supports an independent IO voltage domain for the sideband signals.
      Refer, PCI Express M.2 Specification r4.0, sec 3.1.15.1 for more details.
    maxItems: 1

  pwrdis-gpios:
    description: GPIO input to Power Disable (PWRDIS) signal. This signal is
      used by the host system to disable power on the M.2 card. Refer, PCI
      Express M.2 Specification r4.0, sec 3.3.5.2 for more details.
    maxItems: 1

  pln-gpios:
    description: GPIO output to Power Loss Notification (PLN#) signal. This
      signal is use to notify the M.2 card by the host system that the power
      loss event is expected to occur. Refer, PCI Express M.2 Specification
      r4.0, sec 3.2.17.1 for more details.
    maxItems: 1

  plas3-gpios:
    description: GPIO output to Power Loss Acknowledge (PLA_S3#) signal. This
      signal is used by the M.2 card to notify the host system, the status of
      the M.2 card's preparation for power loss.
    maxItems: 1

required:
  - compatible
  - vpcie3v3-supply

additionalProperties: false

examples:
  # PCI M.2 Key M connector for SSDs with PCIe interface
  - |
    connector {
        compatible = "pcie-m2-m-connector";
        vpcie3v3-supply = <&vreg_nvme>;

        ports {
            #address-cells = <1>;
            #size-cells = <0>;

            port@0 {
                #address-cells = <1>;
                #size-cells = <0>;

                reg = <0>;

                endpoint@0 {
                    reg = <0>;
                    remote-endpoint = <&pcie6_port0_ep>;
                };
            };
        };
    };
```

## Documentation/devicetree/bindings/display/panel/waveshare,10.1-dsi-touch-a.yaml
```yaml
# SPDX-License-Identifier: (GPL-2.0-only OR BSD-2-Clause)
%YAML 1.2
---
$id: http://devicetree.org/schemas/display/panel/waveshare,10.1-dsi-touch-a.yaml#
$schema: http://devicetree.org/meta-schemas/core.yaml#

title: Waveshare 10.1" DSI Touchscreen Panel (Type A)

maintainers:
  - Arduino SA <support@arduino.cc>

description: |
  The Waveshare 10.1" DSI touchscreen panel Type A is a MIPI DSI display
  panel with integrated capacitive touch controller. This panel requires
  multiple GPIO-controlled power rails and has an integrated backlight
  controller.

allOf:
  - $ref: panel-common.yaml#

properties:
  compatible:
    const: waveshare,10.1-dsi-touch-a

  reg:
    maxItems: 1
    description: DSI virtual channel

  reset-gpio:
    maxItems: 1
    description: GPIO for the reset signal (active high)

  iovcc-gpio:
    maxItems: 1
    description: GPIO to enable IOVCC power rail (active high)

  avdd-gpio:
    maxItems: 1
    description: GPIO to enable AVDD power rail (active high)

  backlight:
    description: |
      Backlight controller phandle. For this panel, the backlight is typically
      controlled through the display MCU GPIO controller.

  port: true

required:
  - compatible
  - reg
  - reset-gpio
  - iovcc-gpio
  - avdd-gpio
  - backlight
  - port

additionalProperties: false

examples:
  - |
    #include <dt-bindings/gpio/gpio.h>

    dsi {
        #address-cells = <1>;
        #size-cells = <0>;

        panel@0 {
            compatible = "waveshare,10.1-dsi-touch-a";
            reg = <0>;
            reset-gpio = <&display_mcu 1 GPIO_ACTIVE_HIGH>;
            iovcc-gpio = <&display_mcu 4 GPIO_ACTIVE_HIGH>;
            avdd-gpio = <&display_mcu 0 GPIO_ACTIVE_HIGH>;
            backlight = <&display_mcu>;

            port {
                panel_in: endpoint {
                    remote-endpoint = <&dsi_out>;
                };
            };
        };
    };
```

## Documentation/devicetree/bindings/media/i2c/galaxycore,gc5035.yaml
```yaml
# SPDX-License-Identifier: (GPL-2.0 OR BSD-2-Clause)
# Copyright (c) 2019 MediaTek Inc.
# Copyright 2020 Google LLC.
%YAML 1.2
---
$id: http://devicetree.org/schemas/media/i2c/galaxycore,gc5035.yaml#
$schema: http://devicetree.org/meta-schemas/core.yaml#

title: Galaxycore Inc. GC5035 CMOS Sensor

maintainers:
  - Tomasz Figa <tfiga@chromium.org>

description: |-
  The Galaxycore Inc. GC5035 is a 5 megapixel, 1/5 inch CMOS 10-bit Bayer image
  sensor that delivers 2592x1944 at 30fps. This chip is programmable through
  an I2C interface. The image output is available via a MIPI CSI-2 interface.

properties:
  compatible:
    const: galaxycore,gc5035

  reg:
    maxItems: 1

  clocks:
    maxItems: 1

  clock-names:
    description:
      Input clock for the sensor.
    items:
      - const: mclk

  clock-frequency:
    description:
      Frequency of the mclk clock in Hz.

  iovdd-supply:
    description:
      Regulator driving the I/O power rail.

  avdd28-supply:
    description:
      Regulator driving the analog power rail.

  dvdd12-supply:
    description:
      Regulator driving the digital power rail.

  resetb-gpios:
    description:
      The GPIO pin that drives the RESETB signal, controlling sensor reset.
      The RESETB signal must be driven low to activate the reset, so the
      GPIO_ACTIVE_LOW flag should be given by default.

  pwdn-gpios:
    description:
      The GPIO pin that drives the PWDN signal, controlling sensor power-down
      mode. The PWDN signal must be driven low to activate the power-down
      mode, so the GPIO_ACTIVE_LOW flag should be given by default.

  port:
    type: object
    additionalProperties: false
    description:
      A node containing an output port node with an endpoint definition
      as documented in
      Documentation/devicetree/bindings/media/video-interfaces.txt

    properties:
      endpoint:
        type: object
        additionalProperties: false

        properties:
          data-lanes:
            items:
              - const: 1
              - const: 2

          link-frequencies: true
          remote-endpoint: true

        required:
          - data-lanes
          - link-frequencies
          - remote-endpoint

    required:
      - endpoint

required:
  - compatible
  - reg
  - clocks
  - clock-names
  - clock-frequency
  - iovdd-supply
  - avdd28-supply
  - dvdd12-supply
  - resetb-gpios
  - pwdn-gpios
  - port

additionalProperties: false

examples:
  - |
    #include <dt-bindings/gpio/gpio.h>

    i2c {
        #address-cells = <1>;
        #size-cells = <0>;

        gc5035: camera@10 {
            compatible = "galaxycore,gc5035";
            reg = <0x10>;

            resetb-gpios = <&pio 111 GPIO_ACTIVE_LOW>;
            pwdn-gpios = <&pio 112 GPIO_ACTIVE_LOW>;
            pinctrl-names = "default";
            pinctrl-0 = <&clk_24m_cam>;

            clocks = <&cam_osc>;
            clock-names = "mclk";
            clock-frequency = <24000000>;

            avdd28-supply = <&mt6358_vcama2_reg>;
            dvdd12-supply = <&mt6358_vcamd_reg>;
            iovdd-supply = <&mt6358_vcamio_reg>;

            port {
                wcam_out: endpoint {
                    remote-endpoint = <&mipi_in_wcam>;
                    data-lanes = <1 2>;
                    link-frequencies = /bits/ 64 <438000000>;
                };
            };
        };
    };
...
```
