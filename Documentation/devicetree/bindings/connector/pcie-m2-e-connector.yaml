## Documentation/devicetree/bindings/media/qcom,camss-ope.yaml
```yaml
# SPDX-License-Identifier: (GPL-2.0 OR BSD-2-Clause)
%YAML 1.2
---
$id: http://devicetree.org/schemas/media/qcom,camss-ope.yaml#
$schema: http://devicetree.org/meta-schemas/core.yaml#

title: Qualcomm Camera Subsystem Offline Processing Engine

maintainers:
  - Loic Poulain <loic.poulain@oss.qualcomm.com>

description:
  The Qualcomm Camera Subsystem (CAMSS) Offline Processing Engine (OPE)
  is a memory-to-memory image processing block used. It supports a
  range of pixel-processing operations such as scaling, cropping, gain
  adjustments, white-balancing, and various format conversions. The OPE
  does not interface directly with image sensors, instead, it processes
  frames sourced from and written back to system memory.

properties:
  compatible:
    const: qcom,qcm2290-camss-ope

  reg:
    maxItems: 5

  reg-names:
    items:
      - const: top
      - const: bus_read
      - const: bus_write
      - const: pipeline
      - const: qos

  clocks:
    maxItems: 5

  clock-names:
    items:
      - const: axi
      - const: core
      - const: iface
      - const: nrt
      - const: top

  interrupts:
    maxItems: 1

  interconnects:
    maxItems: 2

  interconnect-names:
    items:
      - const: config
      - const: data

  iommus:
    maxItems: 2

  operating-points-v2: true

  opp-table:
    type: object

  power-domains:
    maxItems: 2

  power-domain-names:
    items:
      - const: camss
      - const: cx

required:
  - compatible
  - reg
  - reg-names
  - clocks
  - clock-names
  - interrupts
  - interconnects
  - interconnect-names
  - iommus
  - power-domains
  - power-domain-names

additionalProperties: true
```

## Documentation/devicetree/bindings/mfd/waveshare,touchscreen-panel-regulator.yaml
```yaml
# SPDX-License-Identifier: (GPL-2.0-only OR BSD-2-Clause)
%YAML 1.2
---
$id: http://devicetree.org/schemas/mfd/waveshare,touchscreen-panel-regulator.yaml#
$schema: http://devicetree.org/meta-schemas/core.yaml#

title: Waveshare Touchscreen Panel Regulator and GPIO Controller

maintainers:
  - Arduino SA <support@arduino.cc>

description: |
  The Waveshare touchscreen panel regulator is a multi-function device that
  provides GPIO control and power management for Waveshare DSI touchscreen
  panels. It controls various power rails, reset lines, and backlight for
  the display panel.

  This device is typically connected via I2C and provides multiple GPIO
  lines that can be used to control panel power supplies, reset signals,
  and backlight control.

properties:
  compatible:
    const: waveshare,touchscreen-panel-regulator

  reg:
    maxItems: 1
    description: I2C address of the device

  gpio-controller: true

  "#gpio-cells":
    const: 2
    description: |
      The first cell is the GPIO number.
      The second cell is the GPIO flags as defined in
      <dt-bindings/gpio/gpio.h>.

required:
  - compatible
  - reg
  - gpio-controller
  - "#gpio-cells"

additionalProperties: false

examples:
  - |
    #include <dt-bindings/gpio/gpio.h>

    i2c {
        #address-cells = <1>;
        #size-cells = <0>;

        display_mcu: display-mcu@45 {
            compatible = "waveshare,touchscreen-panel-regulator";
            reg = <0x45>;
            gpio-controller;
            #gpio-cells = <2>;
        };

        touchscreen@5d {
            compatible = "goodix,gt9271";
            reg = <0x5d>;
            reset-gpios = <&display_mcu 9 GPIO_ACTIVE_HIGH>;
        };
    };
```

## drivers/firmware/arm_scmi/vendors/qcom/Kconfig
```kconfig
# SPDX-License-Identifier: GPL-2.0-only
menu "ARM SCMI QCOM Vendor Protocols"

config QCOM_SCMI_GENERIC_EXT
	tristate "Qualcomm Technologies, Inc. SCMI Generic Vendor Protocol"
	depends on ARM_SCMI_PROTOCOL || (COMPILE_TEST && OF)
	help
	  The QCOM SCMI vendor protocol provides a generic way of exposing
	  a number of Qualcomm SoC specific features (like memory bus scaling)
	  through a mixture of pre-determined algorithm strings and param_id
	  pairs hosted on the SCMI controller.

	  This driver defines/documents the message IDs used for this
	  communication and also exposes the operations used by the clients.
endmenu
```

## drivers/media/pci/intel/Kconfig
```kconfig
# SPDX-License-Identifier: GPL-2.0-only
config IPU_BRIDGE
	tristate
	depends on ACPI
	depends on I2C

source "drivers/media/pci/intel/ipu3/Kconfig"
```

## drivers/media/pci/intel/ipu6/Kconfig
```kconfig
config VIDEO_INTEL_IPU6
	tristate "Intel IPU6 driver"
	depends on ACPI || COMPILE_TEST
	depends on MEDIA_SUPPORT
	depends on MEDIA_PCI_SUPPORT
	depends on X86 && X86_64
	select IOMMU_IOVA
	select VIDEOBUF2_DMA_CONTIG
	select V4L2_FWNODE
	help
	  This is the 6th Gen Intel Image Processing Unit, found in Intel SoCs
	  and used for capturing images and video from camera sensors.

	  To compile this driver, say Y here! It contains 2 modules -
	  intel_ipu6 and intel_ipu6_isys.
```

## drivers/media/platform/qcom/camss/Kconfig
```kconfig
config VIDEO_QCOM_CAMSS
	tristate "Qualcomm V4L2 Camera Subsystem driver"
	depends on V4L_PLATFORM_DRIVERS
	depends on VIDEO_DEV
	depends on (ARCH_QCOM && IOMMU_DMA) || COMPILE_TEST
	select MEDIA_CONTROLLER
	select VIDEO_V4L2_SUBDEV_API
	select VIDEOBUF2_DMA_SG
	select V4L2_FWNODE

config VIDEO_QCOM_CAMSS_OPE
	tristate "Qualcomm Offline Processing Engine (OPE) driver"
	depends on VIDEO_QCOM_CAMSS
	depends on V4L_PLATFORM_DRIVERS
	depends on VIDEO_DEV
	depends on (ARCH_QCOM && IOMMU_DMA) || COMPILE_TEST
	select V4L2_ISP
	select VIDEOBUF2_DMA_CONTIG
	select VIDEOBUF2_VMALLOC
	help
	  Enable support for the Qualcomm Offline Processing Engine (OPE).
	  OPE is a memory-to-memory ISP block that converts raw Bayer frames
	  to YUV, performing white balance, demosaic, chroma enhancement and
	  downscaling. Found on QCM2290 and related SoCs.

	  To compile this driver as a module, choose M here: the module
	  will be called qcom-camss-ope.
```

## sound/soc/sunxi/Kconfig
```kconfig
menu "SoC Audio support for Allwinner SoCs"
        depends on ARCH_SUNXI

config SND_SUNXI_SOC_CODEC
	tristate "APB on-chip sun4i/sun5i/sun7i CODEC"
	select SND_SOC_GENERIC_DMAENGINE_PCM
	select REGMAP_MMIO
	default y

endmenu
```
