// SPDX-License-Identifier: BSD-3-Clause
/*
 * Copyright (c) Qualcomm Technologies, Inc. and/or its subsidiaries.
 */

/dts-v1/;

#include "glymur-cob.dtsi"
#include "glymur-crd.dtsi"

/ {
	model = "Qualcomm Technologies, Inc. Glymur CRD";
	compatible = "qcom,glymur-crd", "qcom,glymur";
};

&pmcx0102_d_e0_temp_alarm {
	io-channels = <&pmk8850_vadc ADC5_GEN4_DIE_TEMP(0, 3)>;
	io-channel-names = "thermal";
};

&pmh0110_h_e0_temp_alarm {
	io-channels = <&pmk8850_vadc ADC5_GEN4_DIE_TEMP(0, 7)>;
	io-channel-names = "thermal";
};
